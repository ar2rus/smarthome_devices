;payload length on pipe0
.set	RX_PW_P0_LEN = 12


;port aliases
.set	NRF24_PORT = PORTA
.set	NRF24_DDR	 = DDRA
.set	NRF24_PIN	 = PINA

.set	NRF24_CE   =	PA4		; Chip enable
.set	NRF24_CSN  =	PA0		; SPI chip select NOT, active low
.set	NRF24_SCK  =	PA3		; SCK
.set	NRF24_MOSI =	PA1		; MOSI
.set	NRF24_MISO =	PA2		; MISO

;SPI instructions
.equ	NRF24_R_REGISTER	= 0b00000000	;R_REGISTER
.equ	NRF24_W_REGISTER	= 0b00100000	;W_REGISTER
.equ	NRF24_FLUSH_TX		= 0b11100001	;FLUSH_TX
.equ	NRF24_FLUSH_RX		= 0b11100010	;FLUSH_RX
.equ	NRF24_R_RX_PAYLOAD  = 0b01100001	;R_RX_PAYLOAD
.equ	NRF24_W_TX_PAYLOAD  = 0b10100000	;W_TX_PAYLOAD

;registry addresses
.equ	NRF24_REGISTER_CONFIG		= 0x00
.equ	NRF24_REGISTER_SETUP_AW		= 0x03
.equ	NRF24_REGISTER_SETUP_RETR	= 0x04
.equ	NRF24_REGISTER_RF_CH		= 0x05
.equ	NRF24_REGISTER_RF_SETUP		= 0x06
.equ	NRF24_REGISTER_STATUS		= 0x07
.equ	NRF24_REGISTER_OBSERVE_TX	= 0x08
.equ	NRF24_REGISTER_CD			= 0x09
.equ	NRF24_REGISTER_RX_ADDR_P0	= 0x0A
.equ	NRF24_REGISTER_TX_ADDR		= 0x10
.equ	NRF24_REGISTER_RX_PW_P0		= 0x11
.equ	NRF24_REGISTER_FIFO_STATUS	= 0x17

;NRF24 CONFIG registry bits
.equ	NRF24_REGISTER_CONFIG_PRIM_RX		= 0
.equ	NRF24_REGISTER_CONFIG_PWR_UP		= 1
.equ	NRF24_REGISTER_CONFIG_CRCO			= 2
.equ	NRF24_REGISTER_CONFIG_EN_CRC		= 3
.equ	NRF24_REGISTER_CONFIG_MASK_MAX_RT	= 4
.equ	NRF24_REGISTER_CONFIG_MASK_TX_DS	= 5
.equ	NRF24_REGISTER_CONFIG_MASK_RX_DR	= 6

;NRF24 RF_SETUP registry bits
.equ	NRF24_REGISTER_RF_SETUP_LNA_HCURR	= 0
.equ	NRF24_REGISTER_RF_SETUP_RF_PWR_0	= 1
.equ	NRF24_REGISTER_RF_SETUP_RF_PWR_1	= 2
.equ	NRF24_REGISTER_RF_SETUP_RF_DR_HIGH	= 3
.equ	NRF24_REGISTER_RF_SETUP_RF_DR_LOW	= 5

;NRF24 STATUS registry bits
.equ	NRF24_REGISTER_STATUS_TX_FULL		= 0
.equ	NRF24_REGISTER_STATUS_MAX_RT		= 4
.equ	NRF24_REGISTER_STATUS_TX_DS			= 5
.equ	NRF24_REGISTER_STATUS_RX_DR			= 6

.dseg
	nrf24_reg_status:		.byte	1
	nrf24_reg_command:		.byte	1
	nrf24_reg_length:		.byte	1

	nrf24_spi_byte_tx:		.byte	1
	nrf24_spi_byte_rx:		.byte	1
	nrf24_spi_buffer_rx:	.byte	12
	nrf24_spi_buffer_tx:	.byte	12